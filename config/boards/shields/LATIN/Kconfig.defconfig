## config/boards/shields/LATIN/Kconfig.defconfig
```kconfig
# Copyright (c) 2022 The ZMK Contributors
# SPDX-License-Identifier: MIT

if SHIELD_LATIN

config ZMK_KEYBOARD_NAME
    default "Latin-Xiao_ble"
    
config ZMK_SPLIT_ROLE_CENTRAL
    default y

endif


config ZMK_SPLIT
    default n

endif
```

## config/boards/shields/LATIN/Kconfig.shield
```kconfig
# Copyright (c) 2022 The ZMK Contributors
# SPDX-License-Identifier: MIT

config SHIELD_TOTEM_LEFT
    def_bool $(shields_list_contains,totem_left)
```

## config/west.yml
```yaml
manifest:
  remotes:
    - name: zmkfirmware
      url-base: https://github.com/latincompass/zmk-config-LATIN
  projects:
    - name: zmk
      remote: zmkfirmware
      revision: v0.3
      import: app/west.yml
  self:
    path: config
```
